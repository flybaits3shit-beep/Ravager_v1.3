## ravager-v1.3/configs/ravager_v1.3_defconfig
```kconfig
#
# Ravager v1.3 Kernel Configuration
# Linux/x86 6.9.0-AnarchyRavager-v1.3 — Dell Latitude 3120 Tuned
# Rain's Computer Resurrection — Loris, SC
#
# Target Hardware:
#   CPU:   Intel Celeron N5100 (Jasper Lake / Tremont µarch) 4C/4T
#   GPU:   Intel UHD Graphics (PCI ID 8086:4e71)
#   WiFi:  Intel Wi-Fi 6 AX201 160MHz (CNVi)
#   NVMe:  KIOXIA BG4 128GB (KBG40ZNS128G, DRAM-less HMB)
#   Audio: Realtek ALC3246 (Dell variant)
#   RAM:   4GB LPDDR4x (soldered)
#   BT:    Intel AX201 Bluetooth (USB-attached)
#

# ============================================================================
# SECTION 01: GENERAL SETUP — Ravager Identity & Branding
# ============================================================================
CONFIG_LOCALVERSION="-AnarchyRavager-v1.3"
CONFIG_LOCALVERSION_AUTO=y
CONFIG_DEFAULT_HOSTNAME="ravager"
CONFIG_SYSVIPC=y
CONFIG_SYSVIPC_SYSCTL=y
CONFIG_POSIX_MQUEUE=y
CONFIG_POSIX_MQUEUE_SYSCTL=y
CONFIG_WATCH_QUEUE=y
CONFIG_CROSS_MEMORY_ATTACH=y
CONFIG_USELIB=y
CONFIG_AUDIT=y
CONFIG_AUDITSYSCALL=y
CONFIG_AUDIT_TREE=y
CONFIG_AUDIT_ARCH=y

# Kernel compression — LZ4 for Tremont low-power decompression
# CONFIG_KERNEL_GZIP is not set
# CONFIG_KERNEL_BZIP2 is not set
# CONFIG_KERNEL_LZMA is not set
# CONFIG_KERNEL_XZ is not set
# CONFIG_KERNEL_LZO is not set
# CONFIG_KERNEL_ZSTD is not set
CONFIG_KERNEL_LZ4=y

CONFIG_SWAP=y
CONFIG_SYSFS=y
CONFIG_PROC_FS=y
CONFIG_TMPFS=y
CONFIG_TMPFS_POSIX_ACL=y
CONFIG_TMPFS_XATTR=y

# Cgroups (Plasma/systemd requirements)
CONFIG_CGROUPS=y
CONFIG_CGROUP_FAVOR_DYNMODS=y
CONFIG_MEMCG=y
CONFIG_MEMCG_KMEM=y
CONFIG_CGROUP_SCHED=y
CONFIG_FAIR_GROUP_SCHED=y
CONFIG_CFS_BANDWIDTH=y
CONFIG_CGROUP_PIDS=y
CONFIG_CGROUP_FREEZER=y
CONFIG_CGROUP_DEVICE=y
CONFIG_CGROUP_CPUACCT=y
CONFIG_CGROUP_BPF=y
CONFIG_CGROUP_MISC=y
CONFIG_CGROUP_DEBUG=y

# Namespaces (systemd, Flatpak, sandboxing)
CONFIG_NAMESPACES=y
CONFIG_UTS_NS=y
CONFIG_IPC_NS=y
CONFIG_USER_NS=y
CONFIG_PID_NS=y
CONFIG_NET_NS=y
CONFIG_CHECKPOINT_RESTORE=y

# IRQ subsystem
CONFIG_GENERIC_IRQ_CHIP=y
CONFIG_IRQ_DOMAIN=y
CONFIG_IRQ_DOMAIN_HIERARCHY=y
CONFIG_GENERIC_MSI_IRQ=y
CONFIG_GENERIC_MSI_IRQ_DOMAIN=y
CONFIG_IRQ_FORCED_THREADING=y

# RCU — tuned for 4-core desktop responsiveness
CONFIG_TREE_RCU=y
CONFIG_RCU_EXPERT=y
CONFIG_RCU_FANOUT=32
CONFIG_RCU_FANOUT_LEAF=16
CONFIG_RCU_BOOST=y
CONFIG_RCU_BOOST_DELAY=500
CONFIG_RCU_NOCB_CPU=y
CONFIG_RCU_LAZY=y

# ============================================================================
# SECTION 02: PROCESSOR TYPE — Intel Jasper Lake (Tremont µarch)
# ============================================================================
CONFIG_64BIT=y
CONFIG_X86_64=y
CONFIG_X86=y
# CONFIG_GENERIC_CPU is not set
CONFIG_MATOM=y
CONFIG_NR_CPUS=4
CONFIG_X86_LOCAL_APIC=y
CONFIG_X86_IO_APIC=y
CONFIG_X86_MSR=y
CONFIG_X86_CPUID=y
CONFIG_PROCESSOR_SELECT=y
CONFIG_CPU_SUP_INTEL=y
# CONFIG_CPU_SUP_AMD is not set
# CONFIG_CPU_SUP_HYGON is not set
# CONFIG_CPU_SUP_CENTAUR is not set
# CONFIG_CPU_SUP_ZHAOXIN is not set
CONFIG_SCHED_MC=y
CONFIG_SCHED_SMT=y
CONFIG_X86_INTEL_PSTATE=y
CONFIG_X86_ACPI_CPUFREQ=m
CONFIG_X86_SPEEDSTEP_LIB=m
# CONFIG_X86_5LEVEL is not set
CONFIG_X86_DIRECT_GBPAGES=y
CONFIG_X86_CPA_STATISTICS=y
CONFIG_ARCH_HAS_CPU_CACHE_INVALIDATE_MEMREGION=y

# ============================================================================
# SECTION 03: PREEMPTION & TIMER — Desktop Responsiveness
# ============================================================================
CONFIG_PREEMPT=y
# CONFIG_PREEMPT_VOLUNTARY is not set
# CONFIG_PREEMPT_NONE is not set
CONFIG_HZ_1000=y
CONFIG_HZ=1000
CONFIG_NO_HZ_IDLE=y
# CONFIG_NO_HZ_FULL is not set
CONFIG_HIGH_RES_TIMERS=y
CONFIG_SCHED_AUTOGROUP=y

# ============================================================================
# SECTION 04: CPU FREQUENCY — schedutil Default
# ============================================================================
CONFIG_CPU_FREQ=y
CONFIG_CPU_FREQ_DEFAULT_GOV_SCHEDUTIL=y
# CONFIG_CPU_FREQ_DEFAULT_GOV_PERFORMANCE is not set
# CONFIG_CPU_FREQ_DEFAULT_GOV_POWERSAVE is not set
# CONFIG_CPU_FREQ_DEFAULT_GOV_ONDEMAND is not set
# CONFIG_CPU_FREQ_DEFAULT_GOV_CONSERVATIVE is not set
CONFIG_CPU_FREQ_GOV_PERFORMANCE=y
CONFIG_CPU_FREQ_GOV_POWERSAVE=y
CONFIG_CPU_FREQ_GOV_ONDEMAND=y
CONFIG_CPU_FREQ_GOV_CONSERVATIVE=y
CONFIG_CPU_FREQ_GOV_SCHEDUTIL=y

# ============================================================================
# SECTION 05: MEMORY MANAGEMENT — 4GB → ~8GB Effective
# ============================================================================

# Zswap (compressed cache in front of swap)
CONFIG_ZSWAP=y
CONFIG_ZSWAP_DEFAULT_ON=y
CONFIG_ZSWAP_COMPRESSOR_DEFAULT_LZ4=y
CONFIG_ZSWAP_COMPRESSOR_DEFAULT="lz4"
CONFIG_ZSWAP_ZPOOL_DEFAULT_Z3FOLD=y
CONFIG_ZSWAP_ZPOOL_DEFAULT="z3fold"

# ZRAM (compressed RAM block device for swap)
CONFIG_ZRAM=m
CONFIG_ZRAM_DEF_COMP_LZ4=y
CONFIG_ZRAM_DEF_COMP="lz4"
CONFIG_ZRAM_WRITEBACK=y
CONFIG_ZRAM_MULTI_COMP=y

# Compression algorithms
CONFIG_LZ4_COMPRESS=y
CONFIG_LZ4_DECOMPRESS=y
CONFIG_LZ4HC_COMPRESS=y
CONFIG_LZO_COMPRESS=y
CONFIG_LZO_DECOMPRESS=y
CONFIG_ZLIB_INFLATE=y
CONFIG_ZLIB_DEFLATE=y
CONFIG_ZSTD_COMPRESS=y
CONFIG_ZSTD_DECOMPRESS=y

# Z3FOLD allocator (3:1 compression ratio)
CONFIG_Z3FOLD=y

# Transparent Huge Pages (madvise only — no aggressive THP)
CONFIG_TRANSPARENT_HUGEPAGE=y
CONFIG_TRANSPARENT_HUGEPAGE_MADVISE=y
# CONFIG_TRANSPARENT_HUGEPAGE_ALWAYS is not set

# Kernel Same-page Merging (deduplicates identical pages)
CONFIG_KSM=y

# Memory compaction
CONFIG_COMPACTION=y

# Page reporting (for memory balloon drivers — not needed but harmless)
CONFIG_PAGE_REPORTING=y

# ============================================================================
# SECTION 06: BLOCK LAYER / I/O — BFQ Default
# ============================================================================
CONFIG_BLOCK=y
CONFIG_BLK_DEV=y
CONFIG_BLK_DEV_NVME=y
CONFIG_NVME_CORE=y

# I/O schedulers — BFQ default for DRAM-less NVMe
CONFIG_IOSCHED_BFQ=y
CONFIG_DEFAULT_BFQ=y
CONFIG_BFQ_GROUP_IOSCHED=y
CONFIG_MQ_IOSCHED_DEADLINE=y
CONFIG_MQ_IOSCHED_KYBER=y
CONFIG_DEFAULT_IOSCHED="bfq"

# Write-back throttling
CONFIG_BLK_WBT=y
CONFIG_BLK_WBT_MQ=y

# ============================================================================
# SECTION 07: GRAPHICS / DRM — i915 Built-In (Early KMS)
# ============================================================================
CONFIG_DRM=y
CONFIG_DRM_KMS_HELPER=y
CONFIG_DRM_FBDEV_EMULATION=y
CONFIG_DRM_FBDEV_OVERALLOC=100

# Intel i915 — built-in for flicker-free UEFI→Wayland
CONFIG_DRM_I915=y
CONFIG_DRM_I915_FORCE_PROBE=""
CONFIG_DRM_I915_GVT=y
CONFIG_DRM_I915_REQUEST_TIMEOUT=20000

# DMA-BUF (required for Wayland buffer sharing)
CONFIG_DMA_SHARED_BUFFER=y
CONFIG_SYNC_FILE=y

# DRM lease (Wayland compositor requires this)
CONFIG_DRM_LEASE=y

# Backlight
CONFIG_BACKLIGHT_CLASS_DEVICE=y
CONFIG_DRM_PANEL=y

# Remove ALL other GPU drivers
# CONFIG_DRM_AMDGPU is not set
# CONFIG_DRM_RADEON is not set
# CONFIG_DRM_NOUVEAU is not set
# CONFIG_DRM_VMWGFX is not set
# CONFIG_DRM_QXL is not set
# CONFIG_DRM_VIRTIO_GPU is not set
# CONFIG_DRM_VBOXVIDEO is not set
# CONFIG_DRM_AST is not set
# CONFIG_DRM_MGAG200 is not set

# Framebuffer (minimal — DRM/KMS handles display)
CONFIG_FB=y
CONFIG_FB_EFI=y
CONFIG_FB_VESA=y
# CONFIG_FB_NVIDIA is not set
# CONFIG_FB_RIVA is not set
# CONFIG_FB_RADEON is not set

# ============================================================================
# SECTION 08: INPUT DEVICES — Latitude 3120 Input Stack
# ============================================================================
CONFIG_INPUT=y
CONFIG_INPUT_KEYBOARD=y
CONFIG_KEYBOARD_ATKBD=y
CONFIG_INPUT_MOUSE=y
CONFIG_MOUSE_PS2=y
CONFIG_MOUSE_PS2_ELANTECH=y

# I2C touchpad/touchscreen (ELAN)
CONFIG_INPUT_TOUCHSCREEN=y
CONFIG_TOUCHSCREEN_ELAN=m
CONFIG_TOUCHSCREEN_USB_COMPOSITE=m
CONFIG_I2C_HID_ACPI=m
CONFIG_I2C_HID_OF=m

# HID
CONFIG_HID=y
CONFIG_HID_GENERIC=y
CONFIG_HID_BATTERY_STRENGTH=y
CONFIG_HID_MULTITOUCH=m
CONFIG_HID_SENSOR_HUB=m
CONFIG_USB_HID=y

# No PC speaker
# CONFIG_INPUT_PCSPKR is not set

# ============================================================================
# SECTION 09: NETWORKING — WiFi-Only, BBR Default
# ============================================================================
CONFIG_NET=y
CONFIG_INET=y
CONFIG_IPV6=y
CONFIG_NETFILTER=y
CONFIG_NF_CONNTRACK=m
CONFIG_NETFILTER_XTABLES=m
CONFIG_NF_TABLES=m
CONFIG_WIRELESS=y
CONFIG_CFG80211=m
CONFIG_MAC80211=m
CONFIG_RFKILL=m

# TCP congestion — BBR default
CONFIG_TCP_CONG_BBR=y
CONFIG_DEFAULT_TCP_CONG="bbr"
CONFIG_TCP_CONG_CUBIC=y
CONFIG_NET_SCH_FQ=y

# Remove ALL Ethernet drivers (no wired port on Latitude 3120)
# CONFIG_NET_VENDOR_INTEL is not set
# CONFIG_NET_VENDOR_REALTEK is not set
# CONFIG_NET_VENDOR_BROADCOM is not set
# CONFIG_NET_VENDOR_QUALCOMM is not set
# CONFIG_NET_VENDOR_MARVELL is not set
# CONFIG_NET_VENDOR_MELLANOX is not set
# CONFIG_NET_VENDOR_CHELSIO is not set
# CONFIG_NET_VENDOR_CISCO is not set
# CONFIG_NET_VENDOR_AQUANTIA is not set
# CONFIG_NET_VENDOR_AMAZON is not set
# CONFIG_NET_VENDOR_GOOGLE is not set
# CONFIG_NET_VENDOR_MICROSOFT is not set

# ============================================================================
# SECTION 10: WIFI — Intel AX201 Only
# ============================================================================
CONFIG_IWLWIFI=m
CONFIG_IWLMVM=m
CONFIG_IWLWIFI_DEBUG=y
CONFIG_IWLWIFI_LEDS=y
CONFIG_IWLDVM=m

# Remove ALL other WiFi vendors
# CONFIG_RTW88 is not set
# CONFIG_RTW89 is not set
# CONFIG_RTL8XXXU is not set
# CONFIG_ATH9K is not set
# CONFIG_ATH10K is not set
# CONFIG_ATH11K is not set
# CONFIG_ATH12K is not set
# CONFIG_BRCMFMAC is not set
# CONFIG_BRCMSMAC is not set
# CONFIG_MWIFIEX is not set
# CONFIG_MT7921E is not set
# CONFIG_MT76 is not set

# ============================================================================
# SECTION 11: AUDIO — Realtek ALC3246 + SOF
# ============================================================================
CONFIG_SOUND=y
CONFIG_SND=y
CONFIG_SND_PCI=y
CONFIG_SND_HDA_INTEL=y
CONFIG_SND_HDA_CODEC_REALTEK=y
CONFIG_SND_HDA_CODEC_HDMI=y
CONFIG_SND_HDA_GENERIC=y
CONFIG_SND_HDA_POWER_SAVE_DEFAULT=1
CONFIG_SND_HDA_PREALLOC_SIZE=2048

# Sound Open Firmware (SOF) — Jasper Lake audio DSP
CONFIG_SND_SOC=m
CONFIG_SND_SOC_SOF_TOPLEVEL=y
CONFIG_SND_SOC_SOF_PCI=m
CONFIG_SND_SOC_SOF_INTEL_TOPLEVEL=y
CONFIG_SND_SOC_SOF_JASPERLAKE=m
CONFIG_SND_SOC_INTEL_SOF_RT5682_MACH=m

# USB audio (for external DACs/headsets)
CONFIG_SND_USB_AUDIO=m

# ============================================================================
# SECTION 12: USB — xHCI Built-In (Jasper Lake xHCI-only)
# ============================================================================
CONFIG_USB_SUPPORT=y
CONFIG_USB=y
CONFIG_USB_XHCI_HCD=y
CONFIG_USB_XHCI_PCI=y
CONFIG_USB_XHCI_PLATFORM=y

# Remove legacy USB controllers (not present on Jasper Lake)
# CONFIG_USB_EHCI_HCD is not set
# CONFIG_USB_OHCI_HCD is not set
# CONFIG_USB_UHCI_HCD is not set

# USB Type-C
CONFIG_TYPEC=m
CONFIG_TYPEC_UCSI=m
CONFIG_UCSI_ACPI=m

# USB storage
CONFIG_USB_STORAGE=m
CONFIG_USB_UAS=m

# ============================================================================
# SECTION 13: BLUETOOTH — Intel AX201 BT (USB-attached)
# ============================================================================
CONFIG_BT=m
CONFIG_BT_HCIBTUSB=m
CONFIG_BT_INTEL=m
CONFIG_BT_HCIUART=m
CONFIG_BT_BNEP=m
CONFIG_BT_HIDP=m
CONFIG_BT_RFCOMM=m

# Remove non-Intel BT drivers
# CONFIG_BT_HCIBTSDIO is not set
# CONFIG_BT_MTKSDIO is not set
# CONFIG_BT_MTKUART is not set
# CONFIG_BT_HCIBCM203X is not set
# CONFIG_BT_HCIBPA10X is not set

# ============================================================================
# SECTION 14: I2C / SERIAL IO — Jasper Lake LPSS
# ============================================================================
CONFIG_I2C=y
CONFIG_I2C_CHARDEV=m
CONFIG_I2C_DESIGNWARE_CORE=y
CONFIG_I2C_DESIGNWARE_PLATFORM=y
CONFIG_I2C_DESIGNWARE_PCI=y

# Intel LPSS (Low Power Subsystem) — built-in for touchpad/sensors
CONFIG_MFD_INTEL_LPSS=y
CONFIG_MFD_INTEL_LPSS_PCI=y
CONFIG_MFD_INTEL_LPSS_ACPI=y

# SPI (for fingerprint reader if present)
CONFIG_SPI=y
CONFIG_SPI_PXA2XX=m
CONFIG_SPI_PXA2XX_PCI=m

# ============================================================================
# SECTION 15: POWER / THERMAL — Jasper Lake 6W TDP
# ============================================================================
CONFIG_ACPI=y
CONFIG_ACPI_BUTTON=y
CONFIG_ACPI_FAN=y
CONFIG_ACPI_BATTERY=y
CONFIG_ACPI_AC=y
CONFIG_ACPI_PROCESSOR=y
CONFIG_ACPI_THERMAL=y
CONFIG_ACPI_VIDEO=y

# Intel thermal / DPTF
CONFIG_INT340X_THERMAL=m
CONFIG_PROC_THERMAL_MMIO_RAPL=m
CONFIG_INTEL_PCH_THERMAL=m
CONFIG_INTEL_TCC_COOLING=m
CONFIG_INTEL_POWERCLAMP=m
CONFIG_INTEL_RAPL=m

# CPU idle
CONFIG_CPU_IDLE=y
CONFIG_CPU_IDLE_GOV_LADDER=y
CONFIG_CPU_IDLE_GOV_MENU=y
CONFIG_CPU_IDLE_GOV_TEO=y
CONFIG_INTEL_IDLE=y

# ============================================================================
# SECTION 16: FILESYSTEMS
# ============================================================================

# Root filesystem
CONFIG_EXT4_FS=y
CONFIG_EXT4_FS_POSIX_ACL=y
CONFIG_EXT4_FS_SECURITY=y

# USB media / dual-boot support
CONFIG_NTFS3_FS=m
CONFIG_NTFS3_LZX_XPRESS=y
CONFIG_EXFAT_FS=m
CONFIG_VFAT_FS=m
CONFIG_FAT_DEFAULT_UTF8=y
CONFIG_NLS_CODEPAGE_437=y
CONFIG_NLS_ISO8859_1=y
CONFIG_NLS_UTF8=y

# Pseudo-filesystems (systemd/Plasma requirements)
CONFIG_FUSE_FS=m
CONFIG_OVERLAY_FS=m
CONFIG_AUTOFS_FS=m
CONFIG_EFIVARFS_FS=y
CONFIG_CONFIGFS_FS=y
CONFIG_HUGETLBFS=y

# File notification (Baloo file indexer)
CONFIG_INOTIFY_USER=y
CONFIG_FANOTIFY=y
CONFIG_FANOTIFY_ACCESS_PERMISSIONS=y

# ============================================================================
# SECTION 17: SECURITY — AppArmor + Yama + IMA
# ============================================================================
CONFIG_SECURITY=y
CONFIG_SECURITY_APPARMOR=y
CONFIG_DEFAULT_SECURITY_APPARMOR=y
CONFIG_DEFAULT_SECURITY="apparmor"
CONFIG_SECURITY_YAMA=y
CONFIG_INTEGRITY=y
CONFIG_IMA=y
CONFIG_EVM=y
CONFIG_SECURITY_LOCKDOWN_LSM=y
CONFIG_SECURITY_LOCKDOWN_LSM_EARLY=y
CONFIG_LOCK_DOWN_KERNEL_FORCE_NONE=y
CONFIG_SECCOMP=y
CONFIG_SECCOMP_FILTER=y

# Stack protection
CONFIG_STACKPROTECTOR=y
CONFIG_STACKPROTECTOR_STRONG=y
CONFIG_FORTIFY_SOURCE=y
CONFIG_HARDENED_USERCOPY=y

# ============================================================================
# SECTION 18: CRYPTO — AES-NI Hardware Acceleration
# ============================================================================
CONFIG_CRYPTO=y
CONFIG_CRYPTO_AES=y
CONFIG_CRYPTO_AES_NI_INTEL=y
CONFIG_CRYPTO_SHA256=y
CONFIG_CRYPTO_SHA256_SSSE3=y
CONFIG_CRYPTO_SHA512=y
CONFIG_CRYPTO_SHA512_SSSE3=y
CONFIG_CRYPTO_CRC32C=y
CONFIG_CRYPTO_CRC32C_INTEL=y
CONFIG_CRYPTO_CRC32_PCLMUL=y
CONFIG_CRYPTO_GHASH_CLMULNI_INTEL=y
CONFIG_CRYPTO_CHACHA20=y
CONFIG_CRYPTO_CHACHA20_X86_64=y
CONFIG_CRYPTO_POLY1305=y
CONFIG_CRYPTO_POLY1305_X86_64=y
CONFIG_CRYPTO_LZ4=y
CONFIG_CRYPTO_LZ4HC=y
CONFIG_CRYPTO_ZSTD=y
CONFIG_CRYPTO_USER=m
CONFIG_CRYPTO_USER_API=m
CONFIG_CRYPTO_USER_API_HASH=m
CONFIG_CRYPTO_USER_API_SKCIPHER=m
CONFIG_CRYPTO_USER_API_AEAD=m

# ============================================================================
# SECTION 19: VIRTUALIZATION — Entirely Removed
# ============================================================================
# CONFIG_VIRTUALIZATION is not set
# CONFIG_KVM is not set
# CONFIG_KVM_INTEL is not set
# CONFIG_VHOST_NET is not set
# CONFIG_XEN is not set
# CONFIG_PARAVIRT is not set
# CONFIG_HYPERVISOR_GUEST is not set

# ============================================================================
# SECTION 20: DEAD HARDWARE — Removed (Not Present on Latitude 3120)
# ============================================================================

# FireWire
# CONFIG_FIREWIRE is not set

# ISDN
# CONFIG_ISDN is not set

# ATM
# CONFIG_ATM is not set

# DVB / TV tuners
# CONFIG_MEDIA_SUPPORT is not set

# InfiniBand
# CONFIG_INFINIBAND is not set

# Amateur radio
# CONFIG_HAMRADIO is not set

# PCMCIA / CardBus
# CONFIG_PCCARD is not set

# Parallel port
# CONFIG_PARPORT is not set

# Floppy
# CONFIG_BLK_DEV_FD is not set

# IDE (legacy)
# CONFIG_IDE is not set

# SCSI tape
# CONFIG_CHR_DEV_ST is not set

# Gameport / joystick
# CONFIG_GAMEPORT is not set

# ============================================================================
# SECTION 21: CAMERA / IIO / DEBUG
# ============================================================================

# Camera (MIPI CSI-2 pipeline for Latitude 3120 webcam)
CONFIG_MEDIA_SUPPORT=y
CONFIG_MEDIA_USB_SUPPORT=y
CONFIG_USB_VIDEO_CLASS=m
CONFIG_VIDEO_IPU3_CIO2=m

# IIO sensors (accelerometer, gyro for 2-in-1 rotation)
CONFIG_IIO=m
CONFIG_IIO_BUFFER=y
CONFIG_IIO_TRIGGERED_BUFFER=y
CONFIG_HID_SENSOR_IIO_COMMON=m
CONFIG_HID_SENSOR_IIO_TRIGGER=m
CONFIG_HID_SENSOR_ACCEL_3D=m
CONFIG_HID_SENSOR_GYRO_3D=m

# Debug — lean config (enough for troubleshooting, not bloated)
CONFIG_PRINTK=y
CONFIG_BUG=y
CONFIG_DEBUG_KERNEL=y
CONFIG_DEBUG_INFO=y
CONFIG_DEBUG_INFO_DWARF5=y
CONFIG_DEBUG_FS=y
CONFIG_MAGIC_SYSRQ=y
CONFIG_MAGIC_SYSRQ_DEFAULT_ENABLE=0x00b0
CONFIG_DETECT_HUNG_TASK=y
CONFIG_DEFAULT_HUNG_TASK_TIMEOUT=120
# CONFIG_DEBUG_PREEMPT is not set
# CONFIG_DEBUG_SPINLOCK is not set
# CONFIG_DEBUG_MUTEXES is not set
# CONFIG_DEBUG_LOCK_ALLOC is not set
# CONFIG_PROVE_LOCKING is not set
# CONFIG_LOCK_STAT is not set
# CONFIG_FTRACE is not set
# CONFIG_KPROBES is not set
# CONFIG_PROFILING is not set

# ============================================================================
# END OF RAVAGER v1.3 DEFCONFIG
# ============================================================================
```
